
#include <Adafruit_GFX.h>
#include <Adafruit_SSD1306.h>
#include <Wire.h>

#include "dummyLogger.h"
#include "Display.h"
#include "Pins.h"

static String currentStrings[6]; // header + 5 lines
#if defined(USE_BOOTSCREEN)
static const uint8_t bootscreen[] = {
        0x00, 0x60, 0x00, 0x00, 0xe0, 0xff, 0xff, 0xff, 0xff, 0xff, 0xff, 0xff,
        0xff, 0xff, 0xff, 0xff, 0x00, 0x78, 0x00, 0x00, 0xe0, 0xff, 0xff, 0xff,
        0xff, 0xff, 0xff, 0xff, 0xff, 0xff, 0x00, 0xe0, 0x00, 0x7f, 0x00, 0x00,
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        0xfe, 0xff, 0xff, 0xff };
#endif



OLEDDisplay::OLEDDisplay() :
        m_display(128, 64, &Wire, OLED_RST),
        m_isInitialized(false),
        m_isActivated(false)
{
    for (size_t i = 0; i < (sizeof(currentStrings) / sizeof(currentStrings[0])); i++)
    {
        currentStrings[i] = emptyString;
    }
}

OLEDDisplay::~OLEDDisplay()
{
}

// cppcheck-suppress unusedFunction
void OLEDDisplay::Init(bool invert, uint8_t rotation)
{
    pinMode(OLED_RST, OUTPUT);
    digitalWrite(OLED_RST, LOW);
    delay(20);
    digitalWrite(OLED_RST, HIGH);

    Wire.begin(OLED_SDA, OLED_SCL);
    if (!m_display.begin(SSD1306_SWITCHCAPVCC, 0x3c, false, false))
    {
        DlogPrintlnE("SSD1306 allocation failed");
        while (true) { }
    }

    m_display.invertDisplay(invert);
    m_display.setRotation(rotation);
    m_display.clearDisplay();
    m_display.setTextColor(WHITE);
    m_display.setTextSize(1);
    m_display.setCursor(0, 0);
    m_display.print("LoRa APRS Tracker");
    m_display.ssd1306_command(SSD1306_SETCONTRAST);
    m_display.ssd1306_command(1);
    m_display.display();
    m_isInitialized = true;
    m_isActivated = true;
}

#if defined(USE_BOOTSCREEN)
void OLEDDisplay::ShowBootscreen(const String &version, uint16_t x, uint16_t y, uint16_t textColor, uint32_t msPause)
{
    if (m_isInitialized == false)
    {
        return;
    }

    m_display.clearDisplay();
    m_display.drawXBitmap(0, 0, bootscreen, m_display.width(), m_display.height(), 1);
    m_display.setCursor(x, y);
    m_display.setTextColor(textColor);
    m_display.setTextSize(1);
    m_display.print(version);

    m_display.ssd1306_command(SSD1306_SETCONTRAST);
    m_display.ssd1306_command(1);
    m_display.display();

    delay(msPause);
}
#endif

void OLEDDisplay::displayLines(const String &header, const String &line1, const String &line2, const String &line3, const String &line4, const String &line5, uint32_t msPause)
{
    if (m_isInitialized == false)
    {
        return;
    }

    // Store currently displayed strings.
    currentStrings[0] = header;
    currentStrings[1] = line1;
    currentStrings[2] = line2;
    currentStrings[3] = line3;
    currentStrings[4] = line4;
    currentStrings[5] = line5;

    if (m_isActivated)
    {
        m_display.clearDisplay();
        m_display.setTextColor(WHITE);
        m_display.setTextSize(2);
        m_display.setCursor(0, 0);
        m_display.println(header);

        m_display.setTextSize(1);

        if (line1 != emptyString)
        {
            m_display.setCursor(0, 16);
            m_display.println(line1);
        }

        if (line2 != emptyString)
        {
            m_display.setCursor(0, 26);
            m_display.println(line2);
        }

        if (line3 != emptyString)
        {
            m_display.setCursor(0, 36);
            m_display.println(line3);
        }

        if (line4 != emptyString)
        {
            m_display.setCursor(0, 46);
            m_display.println(line4);
        }

        if (line5 != emptyString)
        {
            m_display.setCursor(0, 56);
            m_display.println(line5);
        }

        m_display.ssd1306_command(SSD1306_SETCONTRAST);
        m_display.ssd1306_command(1);
        m_display.display();

        delay(msPause);
    }
}

// cppcheck-suppress unusedFunction
void OLEDDisplay::Display(const String &header, uint32_t msPause)
{
    displayLines(header, emptyString, emptyString, emptyString, emptyString, emptyString, msPause);
}

// cppcheck-suppress unusedFunction
void OLEDDisplay::Display(const String &header, const String &line1, uint32_t msPause)
{
    displayLines(header, line1, emptyString, emptyString, emptyString, emptyString, msPause);
}

// cppcheck-suppress unusedFunction
void OLEDDisplay::Display(const String &header, const String &line1, const String &line2, uint32_t msPause)
{
    displayLines(header, line1, line2, emptyString, emptyString, emptyString, msPause);
}

// cppcheck-suppress unusedFunction
void OLEDDisplay::Display(const String &header, const String &line1, const String &line2, const String &line3, uint32_t msPause)
{
    displayLines(header, line1, line2, line3, emptyString, emptyString, msPause);
}

// cppcheck-suppress unusedFunction
void OLEDDisplay::Display(const String &header, const String &line1, const String &line2, const String &line3, const String &line4, uint32_t msPause)
{
    displayLines(header, line1, line2, line3, line4, emptyString, msPause);
}

// cppcheck-suppress unusedFunction
void OLEDDisplay::Display(const String &header, const String &line1, const String &line2, const String &line3, const String &line4, const String &line5, uint32_t msPause)
{
    displayLines(header, line1, line2, line3, line4, line5, msPause);
}

void OLEDDisplay::Activate(bool activate)
{
    if (m_isInitialized == false)
    {
        return;
    }

    if (activate != m_isActivated)
    {
        m_isActivated = activate;
        m_display.ssd1306_command(activate ? SSD1306_DISPLAYON : SSD1306_DISPLAYOFF);
        m_display.ssd1306_command(1);

        if (activate) // Restore the screen
        {
            displayLines(currentStrings[0], currentStrings[1], currentStrings[2], currentStrings[3], currentStrings[4], currentStrings[5]);
        }
    }
}

bool OLEDDisplay::IsActivated()
{
    return (m_isInitialized && m_isActivated);
}

